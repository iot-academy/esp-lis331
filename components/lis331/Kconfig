## components/lis331/Kconfig
```kconfig
menu "LIS331DLH driver"

    config LIS331_USE_I2C_BUS
        bool "Enable the ESP-IoT-Solution i2c_bus transport backend"
        default n
        help
            Compiles lis331_create_i2c_bus() so the driver can be attached to
            an ESP-IoT-Solution i2c_bus handle. The native ESP-IDF I2C master
            backend (lis331_create()) is always available.

            When enabled, the component manager automatically pulls the
            espressif/i2c_bus dependency from the component registry
            (declared conditionally in idf_component.yml via rules).
endmenu
```

## lis331/Kconfig
```kconfig
menu "LIS331DLH driver"

    config LIS331_USE_I2C_BUS
        bool "Enable the ESP-IoT-Solution i2c_bus transport backend"
        default n
        help
            Compiles lis331_create_i2c_bus() so the driver can be attached to
            an ESP-IoT-Solution i2c_bus handle. The native ESP-IDF I2C master
            backend (lis331_create()) is always available. Requires the i2c_bus
            component in the build.
endmenu
```
